## boards/shields/aimless78/Kconfig.shield
```kconfig
config SHIELD_AIMLESS78_LEFT
    def_bool $(shields_list_contains,aimless78_left)

config SHIELD_AIMLESS78_RIGHT
    def_bool $(shields_list_contains,aimless78_right)
```
